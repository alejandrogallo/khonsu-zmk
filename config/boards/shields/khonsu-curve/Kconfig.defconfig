## config/boards/shields/khonsu-curve/Kconfig.defconfig
```kconfig
if SHIELD_KHONSU_CURVE

config ZMK_KEYBOARD_NAME
    default "The Khonsu Curve"

endif
```

## config/boards/shields/khonsu_curve/Kconfig.defconfig
```kconfig
if SHIELD_KHONSU_CURVE

config ZMK_KEYBOARD_NAME
    default "CurveKhonsu"

endif
```

## config/boards/shields/khorne/Kconfig.defconfig
```kconfig
if SHIELD_KHORNE_LEFT

config ZMK_KEYBOARD_NAME
    default "Khonsu Khorne"

config ZMK_SPLIT_ROLE_CENTRAL
    default y

endif

if SHIELD_KHORNE_LEFT || SHIELD_KHORNE_RIGHT

config ZMK_SPLIT
    default y

endif
```

## config/boards/shields/khorne/Kconfig.shield
```kconfig
config SHIELD_KHORNE_LEFT
    def_bool $(shields_list_contains,khorne_left)

config SHIELD_KHORNE_RIGHT
    def_bool $(shields_list_contains,khorne_right)
```
